## west.yml
```yaml
manifest:
  remotes:
    - name: JsmnRepo
      url-base: https://github.com/zserge
    - name: LairdCP
      url-base: https://github.com/LairdCP

  # Please add items below based on alphabetical order.
  # These dependencies may need updating if new features are added to the firmware.
  projects:
    - name: jsmn
      path: modules/jsmn
      revision: 7b6858a5855299d173c5ab2b46e611bf9961cbef
      remote: JsmnRepo
    - name: mg100_firmware
      revision: 116dd49c6131f840b188b097f54c2dc35aa7adbf
      remote: LairdCP
    - name: zephyr
      west-commands: scripts/west-commands.yml
      revision: 0604bd5f53e828a383a10673f4a8cc2b5fce1d4e
      remote: LairdCP
      import: true
    - name: zephyr_framework
      path: modules/framework
      revision: fd546c5341075a172f243aaefad23c465fdf2c79
      remote: LairdCP
    - name: zephyr-hal-lairdconnectivity
      path: zephyr/ext/hal/lairdconnectivity
      revision: f2e46c9ad8da72868d48b1eb2daf623c97817b42
      remote: LairdCP
    - name: zephyr_boards
      path: zephyr/boards/arm
      revision: 754250f13fecd7581ff6aeb81a0ba76865d06400
      remote: LairdCP

  self:
    path: mg100_firmware_public_manifest
```
